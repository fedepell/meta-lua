## conf/layer.conf
```bitbake
# We have a conf and classes directory, add to BBPATH
BBPATH .= ":${LAYERDIR}"

# We have recipes-* directories, add to BBFILES
BBFILES += " \
	${LAYERDIR}/recipes/*/*.bb \
	${LAYERDIR}/recipes/*/*.bbappend \
	${LAYERDIR}/recipes-*/*/*.bb \
	${LAYERDIR}/recipes-*/*/*.bbappend \
	"

BBFILE_COLLECTIONS += "lua"
BBFILE_PATTERN_lua = "^${LAYERDIR}/"
BBFILE_PRIORITY_lua = "6"

LAYERDEPENDS_lua = "core"
LAYERSERIES_COMPAT_lua = "dunfell"
```
